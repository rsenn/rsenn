## skills/tool-registry/qstack/modules/Config.in
```kconfig
# First cut: the options below were read from each project's CMakeLists.txt on 2026-11-20
# (option() lines only). Check them against the project before relying on one.

config PROJ_modules
	bool "qjs-modules"
	default y
if PROJ_modules
config PROJ_modules__LINK_STATIC
	bool "LINK_STATIC"
	default y if STATIC_LINK
config PROJ_modules__MODULE_BCRYPT
	bool "MODULE_BCRYPT"
config PROJ_modules__MODULE_DIGEST
	bool "MODULE_DIGEST"
config PROJ_modules__MODULE_SERIAL
	bool "MODULE_SERIAL"
config PROJ_modules__MODULE_GPIO
	bool "MODULE_GPIO"
config PROJ_modules__MODULE_WASM
	bool "MODULE_WASM"
endif

config PROJ_ffi
	bool "qjs-ffi"
if PROJ_ffi
config PROJ_ffi__ENABLE_TCC
	bool "ENABLE_TCC"
endif

config PROJ_lws
	bool "qjs-lws"
	select PROJ_modules
if PROJ_lws
config PROJ_lws__BUILD_LIBWEBSOCKETS
	bool "BUILD_LIBWEBSOCKETS"
config PROJ_lws__WITH_SSL
	bool "WITH_SSL"
	default y
config PROJ_lws__WITH_MBEDTLS
	bool "WITH_MBEDTLS"
	depends on PROJ_lws__WITH_SSL
config PROJ_lws__WITH_HTTP2
	bool "WITH_HTTP2"
config PROJ_lws__USE_EPOLL
	bool "USE_EPOLL"
	default y
endif

config PROJ_opencv
	bool "qjs-opencv"
	depends on !TARGET__WASI
if PROJ_opencv
config PROJ_opencv__USE_FEATURE2D
	bool "USE_FEATURE2D"
config PROJ_opencv__USE_BARCODE
	bool "USE_BARCODE"
config PROJ_opencv__USE_LIBCAMERA
	bool "USE_LIBCAMERA"
config PROJ_opencv__USE_LCCV
	bool "USE_LCCV"
	depends on PROJ_opencv__USE_LIBCAMERA
config PROJ_opencv__ENABLE_LTO
	bool "ENABLE_LTO"
endif

config PROJ_sound
	bool "qjs-sound"
	select PROJ_modules

config PROJ_nanovg
	bool "qjs-nanovg"

config PROJ_glfw
	bool "qjs-glfw"
	depends on !TARGET__WASI
if PROJ_glfw
config PROJ_glfw__BUILD_GLFW
	bool "BUILD_GLFW"
config PROJ_glfw__USE_GL3W
	bool "USE_GL3W"
endif

config PROJ_imgui
	bool "qjs-imgui"
	depends on !TARGET__WASI
	select PROJ_glfw

config PROJ_rgfw
	bool "qjs-rgfw"

config PROJ_debugger
	bool "qjs-debugger"
	select PROJ_modules
```
